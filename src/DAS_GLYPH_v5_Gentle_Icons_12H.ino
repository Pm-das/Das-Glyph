/*
  DAS GLYPH v5.0 — GENTLE UI, CUSTOM ICONS, 12-HOUR CLOCK
  ESP32-C3 Super Mini + SSD1306 128x64 I2C
  OLED: SDA GPIO8, SCL GPIO9
  Buttons: GPIO3 and GPIO4, each connected to GND
  Libraries: Adafruit GFX, Adafruit SSD1306, ArduinoJson

  Button 1:
    Home: open launcher
    Launcher: move selection down
    App: cycle action / option
  Button 2:
    Short press: select / action
    Long press: back to launcher (or home from launcher)

  No ChronosESP32. No BLE notification dependency.
*/

#include <WiFi.h>
#include <WiFiClientSecure.h>
#include <HTTPClient.h>
#include <ArduinoJson.h>
#include <Wire.h>
#include <Adafruit_GFX.h>
#include <Adafruit_SSD1306.h>
#include <time.h>
#include <math.h>

// Create secrets.h from secrets.example.h and enter local Wi-Fi credentials.
#include "secrets.h"

const float LATITUDE = 11.0510;
const float LONGITUDE = 76.0711;

#define OLED_SDA 8
#define OLED_SCL 9
#define BUTTON_1 3
#define BUTTON_2 4
#define OLED_ADDRESS 0x3C

Adafruit_SSD1306 display(128, 64, &Wire, -1);

// ---------- Imported OLED Animation Maker boot frames (128x64) ----------
const uint8_t PROGMEM frame0[1024] = {
  0x00, 0x00, 0x00, 0x00, 0x00, 0x00, 0x00, 0x00, 0x00, 0x00, 0x00, 0x00, 0x00, 0x00, 0x00, 0x00,
  0x00, 0x00, 0x00, 0x00, 0x00, 0x00, 0x00, 0x00, 0x00, 0x00, 0x00, 0x00, 0x00, 0x00, 0x00, 0x00,
  0x00, 0x00, 0x00, 0x00, 0x00, 0x00, 0x00, 0x00, 0x00, 0x00, 0x00, 0x00, 0x00, 0x00, 0x00, 0x00,
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  0x00, 0x00, 0x00, 0x00, 0x00, 0x00, 0x00, 0x00, 0x00, 0x00, 0x00, 0x00, 0x00, 0x00, 0x00, 0x00
};

const uint8_t PROGMEM frame1[1024] = {
  0x00, 0x00, 0x00, 0x00, 0x00, 0x00, 0x00, 0x00, 0x00, 0x00, 0x00, 0x00, 0x00, 0x00, 0x00, 0x00,
  0x00, 0x00, 0x00, 0x00, 0x00, 0x00, 0x00, 0x00, 0x00, 0x00, 0x00, 0x00, 0x00, 0x00, 0x00, 0x00,
  0x00, 0x00, 0x00, 0x00, 0x00, 0x00, 0x00, 0x00, 0x00, 0x00, 0x00, 0x00, 0x00, 0x00, 0x00, 0x00,
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  0x00, 0x00, 0x00, 0x00, 0x00, 0x00, 0x00, 0x00, 0x00, 0x00, 0x00, 0x00, 0x00, 0x00, 0x00, 0x00
};

const uint8_t PROGMEM frame2[1024] = {
  0x00, 0x00, 0x00, 0x00, 0x00, 0x00, 0x00, 0x00, 0x00, 0x00, 0x00, 0x00, 0x00, 0x00, 0x00, 0x00,
  0x00, 0x00, 0x00, 0x00, 0x00, 0x00, 0x00, 0x00, 0x00, 0x00, 0x00, 0x00, 0x00, 0x00, 0x00, 0x00,
  0x00, 0x00, 0x00, 0x00, 0x00, 0x00, 0x00, 0x00, 0x00, 0x00, 0x00, 0x00, 0x00, 0x00, 0x00, 0x00,
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  0x00, 0x00, 0x00, 0x00, 0x00, 0x00, 0x00, 0x00, 0x00, 0x00, 0x00, 0x00, 0x00, 0x00, 0x00, 0x00
};

const uint8_t PROGMEM frame3[1024] = {
  0x00, 0x00, 0x00, 0x00, 0x00, 0x00, 0x00, 0x00, 0x00, 0x00, 0x00, 0x00, 0x00, 0x00, 0x00, 0x00,
  0x00, 0x00, 0x00, 0x00, 0x00, 0x00, 0x00, 0x00, 0x00, 0x00, 0x00, 0x00, 0x00, 0x00, 0x00, 0x00,
  0x00, 0x00, 0x00, 0x00, 0x00, 0x00, 0x00, 0x00, 0x00, 0x00, 0x00, 0x00, 0x00, 0x00, 0x00, 0x00,
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  0x00, 0x00, 0x00, 0x00, 0x00, 0x00, 0x00, 0x00, 0x00, 0x00, 0x00, 0x00, 0x00, 0x00, 0x00, 0x00
};

const uint8_t PROGMEM frame4[1024] = {
  0x00, 0x00, 0x00, 0x00, 0x00, 0x00, 0x00, 0x00, 0x00, 0x00, 0x00, 0x00, 0x00, 0x00, 0x00, 0x00,
  0x00, 0x00, 0x00, 0x00, 0x00, 0x00, 0x00, 0x00, 0x00, 0x00, 0x00, 0x00, 0x00, 0x00, 0x00, 0x00,
  0x00, 0x00, 0x00, 0x00, 0x00, 0x00, 0x00, 0x00, 0x00, 0x00, 0x00, 0x00, 0x00, 0x00, 0x00, 0x00,
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  0x00, 0x00, 0x00, 0x00, 0x00, 0x00, 0x00, 0x00, 0x00, 0x00, 0x00, 0x00, 0x00, 0x00, 0x00, 0x00
};

const uint8_t PROGMEM frame5[1024] = {
  0x00, 0x00, 0x00, 0x00, 0x00, 0x00, 0x00, 0x00, 0x00, 0x00, 0x00, 0x00, 0x00, 0x00, 0x00, 0x00,
  0x00, 0x00, 0x00, 0x00, 0x00, 0x00, 0x00, 0x00, 0x00, 0x00, 0x00, 0x00, 0x00, 0x00, 0x00, 0x00,
  0x00, 0x00, 0x00, 0x00, 0x00, 0x00, 0x00, 0x00, 0x00, 0x00, 0x00, 0x00, 0x00, 0x00, 0x00, 0x00,
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  0x00, 0x00, 0x00, 0x00, 0x00, 0x00, 0x00, 0x00, 0x00, 0x00, 0x00, 0x00, 0x00, 0x00, 0x00, 0x00
};

const uint8_t PROGMEM frame6[1024] = {
  0x00, 0x00, 0x00, 0x00, 0x00, 0x00, 0x00, 0x00, 0x00, 0x00, 0x00, 0x00, 0x00, 0x00, 0x00, 0x00,
  0x00, 0x00, 0x00, 0x00, 0x00, 0x00, 0x00, 0x00, 0x00, 0x00, 0x00, 0x00, 0x00, 0x00, 0x00, 0x00,
  0x00, 0x00, 0x00, 0x00, 0x00, 0x00, 0x00, 0x00, 0x00, 0x00, 0x00, 0x00, 0x00, 0x00, 0x00, 0x00,
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  0x00, 0x00, 0x00, 0x00, 0x00, 0x00, 0x00, 0x00, 0x00, 0x00, 0x00, 0x00, 0x00, 0x00, 0x00, 0x00
};

const uint8_t PROGMEM frame7[1024] = {
  0x00, 0x00, 0x00, 0x00, 0x00, 0x00, 0x00, 0x00, 0x00, 0x00, 0x00, 0x00, 0x00, 0x00, 0x00, 0x00,
  0x00, 0x00, 0x00, 0x00, 0x00, 0x00, 0x00, 0x00, 0x00, 0x00, 0x00, 0x00, 0x00, 0x00, 0x00, 0x00,
  0x00, 0x00, 0x00, 0x00, 0x00, 0x00, 0x00, 0x00, 0x00, 0x00, 0x00, 0x00, 0x00, 0x00, 0x00, 0x00,
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  0x00, 0x00, 0x00, 0x00, 0x00, 0x00, 0x00, 0x00, 0x00, 0x00, 0x00, 0x00, 0x00, 0x00, 0x00, 0x00
};

const uint8_t PROGMEM frame8[1024] = {
  0x00, 0x00, 0x00, 0x00, 0x00, 0x00, 0x00, 0x00, 0x00, 0x00, 0x00, 0x00, 0x00, 0x00, 0x00, 0x00,
  0x00, 0x00, 0x00, 0x00, 0x00, 0x00, 0x00, 0x00, 0x00, 0x00, 0x00, 0x00, 0x00, 0x00, 0x00, 0x00,
  0x00, 0x00, 0x00, 0x00, 0x00, 0x00, 0x00, 0x00, 0x00, 0x00, 0x00, 0x00, 0x00, 0x00, 0x00, 0x00,
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  0x00, 0x00, 0x00, 0x00, 0x00, 0x00, 0x00, 0x00, 0x00, 0x00, 0x00, 0x00, 0x00, 0x00, 0x00, 0x00
};

const uint8_t PROGMEM frame9[1024] = {
  0x00, 0x00, 0x00, 0x00, 0x00, 0x00, 0x00, 0x00, 0x00, 0x00, 0x00, 0x00, 0x00, 0x00, 0x00, 0x00,
  0x00, 0x00, 0x00, 0x00, 0x00, 0x00, 0x00, 0x00, 0x00, 0x00, 0x00, 0x00, 0x00, 0x00, 0x00, 0x00,
  0x00, 0x00, 0x00, 0x00, 0x00, 0x00, 0x00, 0x00, 0x00, 0x00, 0x00, 0x00, 0x00, 0x00, 0x00, 0x00,
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  0x00, 0x00, 0x00, 0x00, 0x00, 0x00, 0x00, 0x00, 0x00, 0x00, 0x00, 0x00, 0x00, 0x00, 0x00, 0x00
};

const uint8_t PROGMEM frame10[1024] = {
  0x00, 0x00, 0x00, 0x00, 0x00, 0x00, 0x00, 0x00, 0x00, 0x00, 0x00, 0x00, 0x00, 0x00, 0x00, 0x00,
  0x00, 0x00, 0x00, 0x00, 0x00, 0x00, 0x00, 0x00, 0x00, 0x00, 0x00, 0x00, 0x00, 0x00, 0x00, 0x00,
  0x00, 0x00, 0x00, 0x00, 0x00, 0x00, 0x00, 0x00, 0x00, 0x00, 0x00, 0x00, 0x00, 0x00, 0x00, 0x00,
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  0x00, 0x00, 0x00, 0x00, 0x00, 0x00, 0x00, 0x00, 0x00, 0x00, 0x00, 0x00, 0x00, 0x00, 0x00, 0x00
};

const uint8_t PROGMEM frame11[1024] = {
  0x00, 0x00, 0x00, 0x00, 0x00, 0x00, 0x00, 0x00, 0x00, 0x00, 0x00, 0x00, 0x00, 0x00, 0x00, 0x00,
  0x00, 0x00, 0x00, 0x00, 0x00, 0x00, 0x00, 0x00, 0x00, 0x00, 0x00, 0x00, 0x00, 0x00, 0x00, 0x00,
  0x00, 0x00, 0x00, 0x00, 0x00, 0x00, 0x00, 0x00, 0x00, 0x00, 0x00, 0x00, 0x00, 0x00, 0x00, 0x00,
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  0x00, 0x00, 0x00, 0x00, 0x00, 0x00, 0x00, 0x00, 0x00, 0x00, 0x00, 0x00, 0x00, 0x00, 0x00, 0x00
};

const uint8_t PROGMEM frame12[1024] = {
  0x00, 0x00, 0x00, 0x00, 0x00, 0x00, 0x00, 0x00, 0x00, 0x00, 0x00, 0x00, 0x00, 0x00, 0x00, 0x00,
  0x00, 0x00, 0x00, 0x00, 0x00, 0x00, 0x00, 0x00, 0x00, 0x00, 0x00, 0x00, 0x00, 0x00, 0x00, 0x00,
  0x00, 0x00, 0x00, 0x00, 0x00, 0x00, 0x00, 0x00, 0x00, 0x00, 0x00, 0x00, 0x00, 0x00, 0x00, 0x00,
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  0x00, 0x00, 0x00, 0x00, 0x00, 0x00, 0x00, 0x00, 0x00, 0x00, 0x00, 0x00, 0x00, 0x00, 0x00, 0x00
};

const uint8_t PROGMEM frame13[1024] = {
  0x00, 0x00, 0x00, 0x00, 0x00, 0x00, 0x00, 0x00, 0x00, 0x00, 0x00, 0x00, 0x00, 0x00, 0x00, 0x00,
  0x00, 0x00, 0x00, 0x00, 0x00, 0x00, 0x00, 0x00, 0x00, 0x00, 0x00, 0x00, 0x00, 0x00, 0x00, 0x00,
  0x00, 0x00, 0x00, 0x00, 0x00, 0x00, 0x00, 0x00, 0x00, 0x00, 0x00, 0x00, 0x00, 0x00, 0x00, 0x00,
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  0x00, 0x00, 0x00, 0x00, 0x00, 0x00, 0x00, 0x00, 0x00, 0x00, 0x00, 0x00, 0x00, 0x00, 0x00, 0x00
};

const uint8_t PROGMEM frame14[1024] = {
  0x00, 0x00, 0x00, 0x00, 0x00, 0x00, 0x00, 0x00, 0x00, 0x00, 0x00, 0x00, 0x00, 0x00, 0x00, 0x00,
  0x00, 0x00, 0x00, 0x00, 0x00, 0x00, 0x00, 0x00, 0x00, 0x00, 0x00, 0x00, 0x00, 0x00, 0x00, 0x00,
  0x00, 0x00, 0x00, 0x00, 0x00, 0x00, 0x00, 0x00, 0x00, 0x00, 0x00, 0x00, 0x00, 0x00, 0x00, 0x00,
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  0x00, 0x00, 0x00, 0x00, 0x00, 0x00, 0x00, 0x00, 0x00, 0x00, 0x00, 0x00, 0x00, 0x00, 0x00, 0x00
};

const uint8_t PROGMEM frame15[1024] = {
  0x00, 0x00, 0x00, 0x00, 0x00, 0x00, 0x00, 0x00, 0x00, 0x00, 0x00, 0x00, 0x00, 0x00, 0x00, 0x00,
  0x00, 0x00, 0x00, 0x00, 0x00, 0x00, 0x00, 0x00, 0x00, 0x00, 0x00, 0x00, 0x00, 0x00, 0x00, 0x00,
  0x00, 0x00, 0x00, 0x00, 0x00, 0x00, 0x00, 0x00, 0x00, 0x00, 0x00, 0x00, 0x00, 0x00, 0x00, 0x00,
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  0x00, 0x00, 0x00, 0x00, 0x00, 0x00, 0x00, 0x00, 0x00, 0x00, 0x00, 0x00, 0x00, 0x00, 0x00, 0x00
};

const uint8_t PROGMEM frame16[1024] = {
  0x00, 0x00, 0x00, 0x00, 0x00, 0x00, 0x00, 0x00, 0x00, 0x00, 0x00, 0x00, 0x00, 0x00, 0x00, 0x00,
  0x00, 0x00, 0x00, 0x00, 0x00, 0x00, 0x00, 0x00, 0x00, 0x00, 0x00, 0x00, 0x00, 0x00, 0x00, 0x00,
  0x00, 0x00, 0x00, 0x00, 0x00, 0x00, 0x00, 0x00, 0x00, 0x00, 0x00, 0x00, 0x00, 0x00, 0x00, 0x00,
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  0x00, 0x00, 0x00, 0x00, 0x00, 0x00, 0x00, 0x00, 0x00, 0x00, 0x00, 0x00, 0x00, 0x00, 0x00, 0x00
};

const uint8_t PROGMEM frame17[1024] = {
  0x00, 0x00, 0x00, 0x00, 0x00, 0x00, 0x00, 0x00, 0x00, 0x00, 0x00, 0x00, 0x00, 0x00, 0x00, 0x00,
  0x00, 0x00, 0x00, 0x00, 0x00, 0x00, 0x00, 0x00, 0x00, 0x00, 0x00, 0x00, 0x00, 0x00, 0x00, 0x00,
  0x00, 0x00, 0x00, 0x00, 0x00, 0x00, 0x00, 0x00, 0x00, 0x00, 0x00, 0x00, 0x00, 0x00, 0x00, 0x00,
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  0x00, 0x00, 0x00, 0x00, 0x00, 0x00, 0x00, 0x00, 0x00, 0x00, 0x00, 0x00, 0x00, 0x00, 0x00, 0x00
};

const uint8_t PROGMEM frame18[1024] = {
  0x00, 0x00, 0x00, 0x00, 0x00, 0x00, 0x00, 0x00, 0x00, 0x00, 0x00, 0x00, 0x00, 0x00, 0x00, 0x00,
  0x00, 0x00, 0x00, 0x00, 0x00, 0x00, 0x00, 0x00, 0x00, 0x00, 0x00, 0x00, 0x00, 0x00, 0x00, 0x00,
  0x00, 0x00, 0x00, 0x00, 0x00, 0x00, 0x00, 0x00, 0x00, 0x00, 0x00, 0x00, 0x00, 0x00, 0x00, 0x00,
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  0x00, 0x00, 0x00, 0x00, 0x00, 0x00, 0x00, 0x00, 0x00, 0x00, 0x00, 0x00, 0x00, 0x00, 0x00, 0x00
};

const uint8_t PROGMEM frame19[1024] = {
  0x00, 0x00, 0x00, 0x00, 0x00, 0x00, 0x00, 0x00, 0x00, 0x00, 0x00, 0x00, 0x00, 0x00, 0x00, 0x00,
  0x00, 0x00, 0x00, 0x00, 0x00, 0x00, 0x00, 0x00, 0x00, 0x00, 0x00, 0x00, 0x00, 0x00, 0x00, 0x00,
  0x00, 0x00, 0x00, 0x00, 0x00, 0x00, 0x00, 0x00, 0x00, 0x00, 0x00, 0x00, 0x00, 0x00, 0x00, 0x00,
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  0x00, 0x00, 0x00, 0x00, 0x00, 0x00, 0x00, 0x00, 0x00, 0x00, 0x00, 0x00, 0x00, 0x00, 0x00, 0x00
};

const uint8_t PROGMEM frame20[1024] = {
  0x00, 0x00, 0x00, 0x00, 0x00, 0x00, 0x00, 0x00, 0x00, 0x00, 0x00, 0x00, 0x00, 0x00, 0x00, 0x00,
  0x00, 0x00, 0x00, 0x00, 0x00, 0x00, 0x00, 0x00, 0x00, 0x00, 0x00, 0x00, 0x00, 0x00, 0x00, 0x00,
  0x00, 0x00, 0x00, 0x00, 0x00, 0x00, 0x00, 0x00, 0x00, 0x00, 0x00, 0x00, 0x00, 0x00, 0x00, 0x00,
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  0x00, 0x00, 0x00, 0x00, 0x00, 0x00, 0x00, 0x00, 0x00, 0x00, 0x00, 0x00, 0x00, 0x00, 0x00, 0x00
};

const uint8_t PROGMEM frame21[1024] = {
  0x00, 0x00, 0x00, 0x00, 0x00, 0x00, 0x00, 0x00, 0x00, 0x00, 0x00, 0x00, 0x00, 0x00, 0x00, 0x00,
  0x00, 0x00, 0x00, 0x00, 0x00, 0x00, 0x00, 0x00, 0x00, 0x00, 0x00, 0x00, 0x00, 0x00, 0x00, 0x00,
  0x00, 0x00, 0x00, 0x00, 0x00, 0x00, 0x00, 0x00, 0x00, 0x00, 0x00, 0x00, 0x00, 0x00, 0x00, 0x00,
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  0x00, 0x00, 0x00, 0x00, 0x00, 0x00, 0x00, 0x00, 0x00, 0x00, 0x00, 0x00, 0x00, 0x00, 0x00, 0x00
};

const uint8_t PROGMEM frame22[1024] = {
  0x00, 0x00, 0x00, 0x00, 0x00, 0x00, 0x00, 0x00, 0x00, 0x00, 0x00, 0x00, 0x00, 0x00, 0x00, 0x00,
  0x00, 0x00, 0x00, 0x00, 0x00, 0x00, 0x00, 0x00, 0x00, 0x00, 0x00, 0x00, 0x00, 0x00, 0x00, 0x00,
  0x00, 0x00, 0x00, 0x00, 0x00, 0x00, 0x00, 0x00, 0x00, 0x00, 0x00, 0x00, 0x00, 0x00, 0x00, 0x00,
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  0x00, 0x00, 0x00, 0x00, 0x00, 0x00, 0x00, 0x00, 0x00, 0x00, 0x00, 0x00, 0x00, 0x00, 0x00, 0x00
};

const uint8_t PROGMEM frame23[1024] = {
  0x00, 0x00, 0x00, 0x00, 0x00, 0x00, 0x00, 0x00, 0x00, 0x00, 0x00, 0x00, 0x00, 0x00, 0x00, 0x00,
  0x00, 0x00, 0x00, 0x00, 0x00, 0x00, 0x00, 0x00, 0x00, 0x00, 0x00, 0x00, 0x00, 0x00, 0x00, 0x00,
  0x00, 0x00, 0x00, 0x00, 0x00, 0x00, 0x00, 0x00, 0x00, 0x00, 0x00, 0x00, 0x00, 0x00, 0x00, 0x00,
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  0x00, 0x00, 0x00, 0x00, 0x00, 0x00, 0x00, 0x00, 0x00, 0x00, 0x00, 0x00, 0x00, 0x00, 0x00, 0x00
};

const uint8_t PROGMEM frame24[1024] = {
  0x00, 0x00, 0x00, 0x00, 0x00, 0x00, 0x00, 0x00, 0x00, 0x00, 0x00, 0x00, 0x00, 0x00, 0x00, 0x00,
  0x00, 0x00, 0x00, 0x00, 0x00, 0x00, 0x00, 0x00, 0x00, 0x00, 0x00, 0x00, 0x00, 0x00, 0x00, 0x00,
  0x00, 0x00, 0x00, 0x00, 0x00, 0x00, 0x00, 0x00, 0x00, 0x00, 0x00, 0x00, 0x00, 0x00, 0x00, 0x00,
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  0x00, 0x00, 0x00, 0x00, 0x00, 0x00, 0x00, 0x00, 0x00, 0x00, 0x00, 0x00, 0x00, 0x00, 0x00, 0x00
};

const uint8_t PROGMEM frame25[1024] = {
  0x00, 0x00, 0x00, 0x00, 0x00, 0x00, 0x00, 0x00, 0x00, 0x00, 0x00, 0x00, 0x00, 0x00, 0x00, 0x00,
  0x00, 0x00, 0x00, 0x00, 0x00, 0x00, 0x00, 0x00, 0x00, 0x00, 0x00, 0x00, 0x00, 0x00, 0x00, 0x00,
  0x00, 0x00, 0x00, 0x00, 0x00, 0x00, 0x00, 0x00, 0x00, 0x00, 0x00, 0x00, 0x00, 0x00, 0x00, 0x00,
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  0x00, 0x00, 0x00, 0x00, 0x00, 0x00, 0x00, 0x00, 0x00, 0x00, 0x00, 0x00, 0x00, 0x00, 0x00, 0x00
};

const uint8_t PROGMEM frame26[1024] = {
  0x00, 0x00, 0x00, 0x00, 0x00, 0x00, 0x00, 0x00, 0x00, 0x00, 0x00, 0x00, 0x00, 0x00, 0x00, 0x00,
  0x00, 0x00, 0x00, 0x00, 0x00, 0x00, 0x00, 0x00, 0x00, 0x00, 0x00, 0x00, 0x00, 0x00, 0x00, 0x00,
  0x00, 0x00, 0x00, 0x00, 0x00, 0x00, 0x00, 0x00, 0x00, 0x00, 0x00, 0x00, 0x00, 0x00, 0x00, 0x00,
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  0x00, 0x00, 0x00, 0x00, 0x00, 0x00, 0x00, 0x00, 0x00, 0x00, 0x00, 0x00, 0x00, 0x00, 0x00, 0x00
};

const uint8_t PROGMEM frame27[1024] = {
  0x00, 0x00, 0x00, 0x00, 0x00, 0x00, 0x00, 0x00, 0x00, 0x00, 0x00, 0x00, 0x00, 0x00, 0x00, 0x00,
  0x00, 0x00, 0x00, 0x00, 0x00, 0x00, 0x00, 0x00, 0x00, 0x00, 0x00, 0x00, 0x00, 0x00, 0x00, 0x00,
  0x00, 0x00, 0x00, 0x00, 0x00, 0x00, 0x00, 0x00, 0x00, 0x00, 0x00, 0x00, 0x00, 0x00, 0x00, 0x00,
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  0x00, 0x00, 0x00, 0x00, 0x00, 0x00, 0x00, 0x00, 0x00, 0x00, 0x00, 0x00, 0x00, 0x00, 0x00, 0x00
};

const uint8_t* const bootFrames[] = {
  frame0, frame1, frame2, frame3, frame4, frame5, frame6, frame7, frame8, frame9, frame10, frame11, frame12, frame13, frame14, frame15, frame16, frame17, frame18, frame19, frame20, frame21, frame22, frame23, frame24, frame25, frame26, frame27
};
const uint8_t BOOT_FRAME_COUNT = sizeof(bootFrames) / sizeof(bootFrames[0]);

// ---------- UI ----------
enum App : uint8_t {
  HOME, LAUNCHER, ANALOG_APP, WEATHER, STOPWATCH, TIMER, SYSTEM, SETTINGS
};
App app = HOME;
int selected = 0;
const char* appNames[] = {
  "Clock", "Analog", "Weather", "Stopwatch", "Timer", "System", "Settings"
};
const int APP_COUNT = 7;

bool use24h = false; // 12-hour clock is the default
bool inverted = false;
bool motionUI = false; // calm, minimal transitions by default
bool timeSynced = false;

unsigned long lastFrame = 0;
unsigned long lastNtpAttempt = 0;
unsigned long lastWifiAttempt = 0;
unsigned long lastWeather = 0;
const unsigned long WEATHER_PERIOD = 15UL * 60UL * 1000UL;

// ---------- Buttons: debounce + press duration ----------
bool rawPrev1 = HIGH, rawPrev2 = HIGH;
bool stable1 = HIGH, stable2 = HIGH;
unsigned long edgeTime1 = 0, edgeTime2 = 0, b2DownAt = 0;
bool longHandled = false;
const unsigned long DEBOUNCE = 28;
const unsigned long LONG_PRESS = 600;

// ---------- Motion / transitions ----------
enum Transition : uint8_t { TRANS_NONE, TRANS_SLIDE_LEFT, TRANS_SLIDE_RIGHT, TRANS_FADE };
Transition transition = TRANS_NONE;
App outgoingApp = HOME;
unsigned long transitionAt = 0;
const unsigned long TRANSITION_MS = 190;
int launcherScroll = 0;
int launcherScrollTarget = 0;
int launcherScrollPx = 0;
unsigned long lastScrollFrame = 0;
uint8_t bootStage = 0;
unsigned long bootAt = 0;

// ---------- Weather ----------
float tempC = 0, feelsC = 0, windKmh = 0;
int humidity = 0, weatherCode = -1;
bool weatherOK = false;
String weatherText = "Waiting for WiFi";
bool weatherRequest = false;

// ---------- Stopwatch ----------
bool swRunning = false;
unsigned long swStart = 0, swElapsed = 0;

// ---------- Timer ----------
unsigned long timerSetMs = 5UL * 60UL * 1000UL;
unsigned long timerRemaining = 5UL * 60UL * 1000UL;
unsigned long timerStarted = 0;
bool timerRunning = false, timerDone = false;

// ---------- Settings ----------
int settingsFocus = 0; // 0 time, 1 motion, 2 inversion

String two(int n) { return n < 10 ? "0" + String(n) : String(n); }

bool getClock(struct tm &t) {
  time_t now = time(nullptr);
  if (now < 1700000000) return false;
  localtime_r(&now, &t);
  return true;
}

String weatherLabel(int c) {
  if (c == 0) return "CLEAR SKY";
  if (c == 1) return "MOSTLY CLEAR";
  if (c == 2) return "PARTLY CLOUDY";
  if (c == 3) return "OVERCAST";
  if (c == 45 || c == 48) return "FOG";
  if (c >= 51 && c <= 57) return "DRIZZLE";
  if (c >= 61 && c <= 67) return "RAIN";
  if (c >= 71 && c <= 77) return "SNOW";
  if (c >= 80 && c <= 82) return "SHOWERS";
  if (c >= 85 && c <= 86) return "SNOW SHOWERS";
  if (c >= 95 && c <= 99) return "THUNDERSTORM";
  return "UNKNOWN";
}

// Small, calm monochrome status icons designed for the 128x64 OLED.
void drawWifiIcon(int x, int y, bool connected) {
  if (connected) {
    display.drawPixel(x + 5, y + 7, SSD1306_WHITE);
    display.drawLine(x + 1, y + 3, x + 3, y + 1, SSD1306_WHITE);
    display.drawLine(x + 3, y + 1, x + 7, y + 1, SSD1306_WHITE);
    display.drawLine(x + 7, y + 1, x + 9, y + 3, SSD1306_WHITE);
    display.drawLine(x + 3, y + 5, x + 4, y + 4, SSD1306_WHITE);
    display.drawLine(x + 4, y + 4, x + 6, y + 4, SSD1306_WHITE);
    display.drawLine(x + 6, y + 4, x + 7, y + 5, SSD1306_WHITE);
  } else {
    display.drawLine(x + 1, y + 1, x + 9, y + 9, SSD1306_WHITE);
    display.drawLine(x + 9, y + 1, x + 1, y + 9, SSD1306_WHITE);
  }
}

void drawBatteryIcon(int x, int y, uint8_t level) {
  display.drawRoundRect(x, y + 1, 13, 7, 1, SSD1306_WHITE);
  display.fillRect(x + 13, y + 3, 2, 3, SSD1306_WHITE);
  uint8_t fillWidth = (uint8_t)((level > 100 ? 100 : level) * 9 / 100);
  if (fillWidth > 0) display.fillRect(x + 2, y + 3, fillWidth, 3, SSD1306_WHITE);
}

void drawWeatherIcon(int x, int y, int code) {
  if (code >= 51 && code <= 99) {
    display.drawCircle(x + 5, y + 5, 3, SSD1306_WHITE);
    display.drawCircle(x + 10, y + 6, 4, SSD1306_WHITE);
    display.drawFastHLine(x + 2, y + 9, 12, SSD1306_WHITE);
    display.drawLine(x + 5, y + 11, x + 3, y + 14, SSD1306_WHITE);
    display.drawLine(x + 10, y + 11, x + 8, y + 14, SSD1306_WHITE);
  } else if (code == 1 || code == 2 || code == 3 || code == 45 || code == 48) {
    display.drawCircle(x + 5, y + 5, 3, SSD1306_WHITE);
    display.drawCircle(x + 10, y + 7, 4, SSD1306_WHITE);
    display.drawFastHLine(x + 2, y + 10, 12, SSD1306_WHITE);
  } else {
    display.drawCircle(x + 7, y + 7, 4, SSD1306_WHITE);
    display.drawLine(x + 7, y, x + 7, y + 2, SSD1306_WHITE);
    display.drawLine(x + 7, y + 12, x + 7, y + 14, SSD1306_WHITE);
    display.drawLine(x, y + 7, x + 2, y + 7, SSD1306_WHITE);
    display.drawLine(x + 12, y + 7, x + 14, y + 7, SSD1306_WHITE);
  }
}

void statusHeader(const char* title) {
  display.setTextColor(SSD1306_WHITE);
  display.setTextSize(1);
  display.setCursor(3, 2);
  display.print(title);
  drawWifiIcon(111, 1, WiFi.status() == WL_CONNECTED);
  display.drawFastHLine(0, 12, 128, SSD1306_WHITE);
}

void enterApp(App next, Transition kind = TRANS_SLIDE_LEFT) {
  outgoingApp = app;
  app = next;
  transition = motionUI ? kind : TRANS_NONE;
  transitionAt = millis();
}

void returnToLauncher() {
  selected = 0;
  launcherScrollTarget = 0;
  enterApp(LAUNCHER, TRANS_SLIDE_RIGHT);
}

void selectApp() {
  switch (selected) {
    case 0: enterApp(HOME, TRANS_SLIDE_RIGHT); break;
    case 1: enterApp(ANALOG_APP); break;
    case 2: weatherRequest = true; enterApp(WEATHER); break;
    case 3: enterApp(STOPWATCH); break;
    case 4: enterApp(TIMER); break;
    case 5: enterApp(SYSTEM); break;
    case 6: enterApp(SETTINGS); break;
  }
}

// ---------- Network ----------
void setupWiFi() {
  WiFi.mode(WIFI_STA);
  WiFi.setSleep(false);
  WiFi.setTxPower(WIFI_POWER_8_5dBm);
  WiFi.begin(WIFI_SSID, WIFI_PASSWORD);
  lastWifiAttempt = millis();
  configTzTime("IST-5:30", "pool.ntp.org", "time.google.com");
}

void networkTick() {
  unsigned long now = millis();
  if (WiFi.status() != WL_CONNECTED && now - lastWifiAttempt > 15000) {
    lastWifiAttempt = now;
    WiFi.disconnect();
    WiFi.begin(WIFI_SSID, WIFI_PASSWORD);
  }

  if (WiFi.status() == WL_CONNECTED && !timeSynced &&
      now - lastNtpAttempt > 8000) {
    lastNtpAttempt = now;
    configTzTime("IST-5:30", "pool.ntp.org", "time.google.com");
    if (time(nullptr) > 1700000000) timeSynced = true;
  }
}

void fetchWeather() {
  if (WiFi.status() != WL_CONNECTED) {
    weatherText = "NO WIFI CONNECTION";
    return;
  }

  WiFiClientSecure client;
  client.setInsecure();
  HTTPClient http;
  http.setConnectTimeout(4000);
  http.setTimeout(5000);

  String url = String("https://api.open-meteo.com/v1/forecast?latitude=") +
    String(LATITUDE, 4) + "&longitude=" + String(LONGITUDE, 4) +
    "&current=temperature_2m,relative_humidity_2m,apparent_temperature,weather_code,wind_speed_10m"
    "&timezone=Asia%2FKolkata";

  if (!http.begin(client, url)) {
    weatherText = "CONNECTION FAILED";
    return;
  }

  int status = http.GET();
  if (status == HTTP_CODE_OK) {
    String body = http.getString();
    JsonDocument doc;
    if (deserializeJson(doc, body) == DeserializationError::Ok) {
      JsonObject cur = doc["current"];
      if (!cur.isNull()) {
        tempC = cur["temperature_2m"] | 0.0;
        feelsC = cur["apparent_temperature"] | 0.0;
        humidity = cur["relative_humidity_2m"] | 0;
        windKmh = cur["wind_speed_10m"] | 0.0;
        weatherCode = cur["weather_code"] | -1;
        weatherText = weatherLabel(weatherCode);
        weatherOK = true;
        lastWeather = millis();
      } else weatherText = "NO DATA";
    } else weatherText = "BAD RESPONSE";
  } else weatherText = "WEATHER OFFLINE";

  http.end();
  client.stop();
}

// ---------- Input ----------
void button1Action() {
  if (app == LAUNCHER) {
    selected = (selected + 1) % APP_COUNT;
    if (selected < launcherScrollTarget) launcherScrollTarget = selected;
    if (selected >= launcherScrollTarget + 4) launcherScrollTarget = selected - 3;
  } else if (app == SETTINGS) {
    settingsFocus = (settingsFocus + 1) % 3;
  } else if (app == STOPWATCH) {
    // B1 resets only when stopwatch is paused.
    if (!swRunning) swElapsed = 0;
  } else if (app == TIMER) {
    // Cycle timer preset: 1, 5, 10 minutes.
    if (timerSetMs == 60000UL) timerSetMs = 5UL * 60000UL;
    else if (timerSetMs == 5UL * 60000UL) timerSetMs = 10UL * 60000UL;
    else timerSetMs = 60000UL;
    if (!timerRunning) timerRemaining = timerSetMs;
    timerDone = false;
  } else {
    enterApp(LAUNCHER, TRANS_SLIDE_LEFT);
  }
}

void button2ShortAction() {
  if (app == HOME) enterApp(LAUNCHER, TRANS_SLIDE_LEFT);
  else if (app == LAUNCHER) selectApp();
  else if (app == WEATHER) weatherRequest = true;
  else if (app == STOPWATCH) {
    if (swRunning) {
      swElapsed += millis() - swStart;
      swRunning = false;
    } else {
      swStart = millis();
      swRunning = true;
    }
  } else if (app == TIMER) {
    if (timerRunning) {
      unsigned long elapsed = millis() - timerStarted;
      timerRemaining = elapsed >= timerRemaining ? 0 : timerRemaining - elapsed;
      timerRunning = false;
      if (!timerRemaining) timerDone = true;
    } else {
      if (timerDone || !timerRemaining) {
        timerRemaining = timerSetMs;
        timerDone = false;
      }
      timerStarted = millis();
      timerRunning = true;
    }
  } else if (app == SETTINGS) {
    if (settingsFocus == 0) use24h = !use24h;
    else if (settingsFocus == 1) motionUI = !motionUI;
    else {
      inverted = !inverted;
      display.invertDisplay(inverted);
    }
  } else if (app == ANALOG_APP || app == SYSTEM) {
    returnToLauncher();
  }
}

void button2LongAction() {
  if (app == LAUNCHER) enterApp(HOME, TRANS_SLIDE_RIGHT);
  else if (app != HOME) returnToLauncher();
  else enterApp(LAUNCHER, TRANS_SLIDE_LEFT);
}

void pollButtons() {
  unsigned long now = millis();
  bool r1 = digitalRead(BUTTON_1);
  bool r2 = digitalRead(BUTTON_2);

  if (r1 != rawPrev1) edgeTime1 = now;
  if (r2 != rawPrev2) edgeTime2 = now;

  if (now - edgeTime1 > DEBOUNCE && r1 != stable1) {
    stable1 = r1;
    if (stable1 == LOW) button1Action();
  }

  if (now - edgeTime2 > DEBOUNCE && r2 != stable2) {
    stable2 = r2;
    if (stable2 == LOW) {
      b2DownAt = now;
      longHandled = false;
    } else if (!longHandled) {
      button2ShortAction();
    }
  }

  if (stable2 == LOW && !longHandled && now - b2DownAt >= LONG_PRESS) {
    longHandled = true;
    button2LongAction();
  }

  rawPrev1 = r1;
  rawPrev2 = r2;
}

// ---------- Graphics primitives ----------
void drawGlyphLogo(int cx, int cy, int scale) {
  // Custom GLYPH monogram: G-like open frame + central glyph.
  int w = 22 * scale, h = 22 * scale;
  display.drawRoundRect(cx - w / 2, cy - h / 2, w, h, 3 * scale, SSD1306_WHITE);
  display.fillRect(cx + 2 * scale, cy - 2 * scale, 8 * scale, 4 * scale, SSD1306_WHITE);
  display.drawLine(cx - 5 * scale, cy - 5 * scale, cx - 5 * scale, cy + 5 * scale, SSD1306_WHITE);
  display.drawLine(cx - 5 * scale, cy + 5 * scale, cx + 4 * scale, cy + 5 * scale, SSD1306_WHITE);
}

void bootAnimation() {
  // Play the imported 28-frame OLED animation once at startup.
  // The original bitmap frames are full-screen 128x64 images.
  const uint16_t frameDelayMs = 33; // approximately 30 FPS
  for (uint8_t i = 0; i < BOOT_FRAME_COUNT; i++) {
    display.clearDisplay();
    display.drawBitmap(0, 0, bootFrames[i], 128, 64, SSD1306_WHITE);
    display.display();
    delay(frameDelayMs);
  }

  // Brief DAS GLYPH title card after the animation.
  display.clearDisplay();
  drawGlyphLogo(64, 25, 1);
  display.setTextSize(1);
  display.setTextColor(SSD1306_WHITE);
  display.setCursor(39, 48);
  display.print("DAS GLYPH");
  display.drawFastHLine(20, 60, 88, SSD1306_WHITE);
  display.display();
  delay(500);
}

void drawTransitionOverlay() {
  if (transition == TRANS_NONE) return;
  unsigned long elapsed = millis() - transitionAt;
  if (elapsed >= TRANSITION_MS) {
    transition = TRANS_NONE;
    return;
  }

  // Sliding black curtain with a bright leading edge.
  int x = map(elapsed, 0, TRANSITION_MS, 128, -8);
  display.fillRect(x, 13, 128 - x, 51, SSD1306_BLACK);
  if (x >= 0 && x < 128) {
    display.drawFastVLine(x, 13, 51, SSD1306_WHITE);
    display.drawFastVLine(x + 1, 13, 51, SSD1306_WHITE);
  }
}

// ---------- HOME ----------
void drawHome() {
  display.clearDisplay();
  display.setTextColor(SSD1306_WHITE);
  struct tm t;
  bool hasTime = getClock(t);

  // Full width top strip
  display.setTextSize(1);
  display.setCursor(3, 2);
  display.print("DAS");
  display.setCursor(25, 2);
  display.print("GLYPH");
  drawWifiIcon(111, 1, WiFi.status() == WL_CONNECTED);
  display.drawFastHLine(0, 12, 128, SSD1306_WHITE);

  if (!hasTime) {
    // Animated clock-sync glyph
    int phase = (millis() / 180) % 8;
    display.drawCircle(64, 34, 12, SSD1306_WHITE);
    display.drawLine(64, 34, 64 + (int)(10 * cosf(phase * PI / 4)),
                     34 + (int)(10 * sinf(phase * PI / 4)), SSD1306_WHITE);
    display.setTextSize(1);
    display.setCursor(37, 53);
    display.print("SYNCING TIME");
  } else {
    int h = t.tm_hour;
    String suffix = "";
    if (!use24h) {
      suffix = t.tm_hour >= 12 ? " PM" : " AM";
      h %= 12;
      if (h == 0) h = 12;
    }

    // Large typography uses nearly full display width.
    display.setTextSize(3);
    display.setCursor(2, 19);
    display.print(two(h));
    display.print(':');
    display.print(two(t.tm_min));

    display.setTextSize(1);
    display.setCursor(99, 23);
    display.print(two(t.tm_sec));
    display.setCursor(99, 34);
    display.print(suffix);

    const char* days[] = {"SUN","MON","TUE","WED","THU","FRI","SAT"};
    const char* months[] = {"JAN","FEB","MAR","APR","MAY","JUN","JUL","AUG","SEP","OCT","NOV","DEC"};
    display.setCursor(3, 47);
    display.print(days[t.tm_wday]);
    display.print("  ");
    display.print(two(t.tm_mday));
    display.print(' ');
    display.print(months[t.tm_mon]);
    display.print(' ');
    display.print(t.tm_year + 1900);

    display.drawFastHLine(0, 57, 128, SSD1306_WHITE);
    display.setCursor(3, 59);
    if (weatherOK) {
      drawWeatherIcon(3, 58, weatherCode);
      display.setCursor(22, 59);
      display.print(weatherText);
      display.setCursor(91, 59);
      display.print(tempC, 1);
      display.print("C");
    } else {
      display.print("B1: OPEN APP MENU");
    }
  }

  drawTransitionOverlay();
  display.display();
}

// ---------- Launcher ----------
void drawAppIcon(int index, int x, int y, bool selectedIcon) {
  uint16_t c = SSD1306_WHITE;
  int cx = x + 8, cy = y + 8;

  if (selectedIcon) display.drawRoundRect(x, y, 17, 17, 4, c);
  switch (index) {
    case 0:
      display.drawCircle(cx, cy, 5, c);
      display.drawLine(cx, cy, cx, cy - 3, c);
      display.drawLine(cx, cy, cx + 3, cy + 2, c);
      break;
    case 1:
      display.drawCircle(cx, cy, 6, c);
      display.drawLine(cx, cy, cx - 2, cy - 4, c);
      display.drawLine(cx, cy, cx + 4, cy, c);
      break;
    case 2:
      display.drawCircle(cx - 2, cy - 1, 3, c);
      display.drawCircle(cx + 3, cy + 1, 4, c);
      display.drawFastHLine(cx - 5, cy + 5, 12, c);
      break;
    case 3:
      display.drawCircle(cx, cy + 1, 5, c);
      display.drawFastHLine(cx - 2, cy - 6, 5, c);
      display.drawLine(cx, cy + 1, cx + 2, cy - 2, c);
      break;
    case 4:
      display.drawRoundRect(cx - 5, cy - 5, 10, 11, 2, c);
      display.drawFastVLine(cx, cy - 3, 4, c);
      break;
    case 5:
      display.drawRect(cx - 5, cy - 5, 10, 10, c);
      display.drawFastHLine(cx - 3, cy - 2, 6, c);
      display.drawFastHLine(cx - 3, cy + 2, 5, c);
      break;
    case 6:
      display.drawCircle(cx, cy, 5, c);
      display.drawCircle(cx, cy, 2, c);
      for (int a = 0; a < 8; a++) {
        float ang = a * PI / 4;
        display.drawPixel(cx + (int)(7 * cosf(ang)), cy + (int)(7 * sinf(ang)), c);
      }
      break;
  }
}

void drawLauncher() {
  display.clearDisplay();
  display.setTextColor(SSD1306_WHITE);
  display.setTextSize(1);
  display.setCursor(3, 2);
  display.print("APPLICATIONS");
  display.setCursor(105, 2);
  display.print(selected + 1);
  display.print('/');
  display.print(APP_COUNT);
  display.drawFastHLine(0, 11, 128, SSD1306_WHITE);

  // Four visible rows; eased scroll uses sub-row pixel motion.
  int target = launcherScrollTarget * 18;
  if (launcherScrollPx < target) launcherScrollPx += max(1, (target - launcherScrollPx) / 3);
  if (launcherScrollPx > target) launcherScrollPx -= max(1, (launcherScrollPx - target) / 3);
  if (abs(launcherScrollPx - target) <= 1) launcherScrollPx = target;

  int first = launcherScrollPx / 18;
  int offset = launcherScrollPx % 18;

  for (int i = first; i < min(APP_COUNT, first + 5); i++) {
    int y = 13 + (i - first) * 18 - offset;
    if (y < -4 || y > 63) continue;

    bool isSelected = i == selected;
    if (isSelected) {
      display.fillRoundRect(1, y, 119, 17, 4, SSD1306_WHITE);
      display.setTextColor(SSD1306_BLACK);
    } else display.setTextColor(SSD1306_WHITE);

    drawAppIcon(i, 3, y, isSelected);
    display.setTextSize(1);
    display.setCursor(25, y + 5);
    display.print(appNames[i]);
    if (isSelected) {
      display.fillTriangle(111, y + 5, 111, y + 12, 116, y + 8,
                           SSD1306_BLACK);
    }
    display.setTextColor(SSD1306_WHITE);
  }

  // Thin scrollbar on the far right
  display.drawFastVLine(125, 14, 47, SSD1306_WHITE);
  int thumbY = 14 + selected * (39 / (APP_COUNT - 1));
  display.fillRoundRect(123, thumbY, 5, 8, 2, SSD1306_WHITE);
  drawTransitionOverlay();
  display.display();
}

// ---------- Other screens ----------
void drawAnalog() {
  display.clearDisplay();
  statusHeader("ANALOG");
  struct tm t;
  if (!getClock(t)) {
    display.setCursor(10, 30);
    display.print("WAITING FOR TIME");
    display.display();
    return;
  }
  const int cx = 64, cy = 37, r = 23;
  display.drawCircle(cx, cy, r, SSD1306_WHITE);
  for (int i = 0; i < 12; i++) {
    float a = (i * 30 - 90) * PI / 180.0f;
    display.drawLine(cx + cosf(a) * 19, cy + sinf(a) * 19,
                     cx + cosf(a) * 23, cy + sinf(a) * 23, SSD1306_WHITE);
  }
  float sa = (t.tm_sec * 6 - 90) * PI / 180.0f;
  float ma = ((t.tm_min + t.tm_sec / 60.0f) * 6 - 90) * PI / 180.0f;
  float ha = (((t.tm_hour % 12) + t.tm_min / 60.0f) * 30 - 90) * PI / 180.0f;
  display.drawLine(cx, cy, cx + cosf(ha) * 11, cy + sinf(ha) * 11, SSD1306_WHITE);
  display.drawLine(cx, cy, cx + cosf(ma) * 17, cy + sinf(ma) * 17, SSD1306_WHITE);
  display.drawLine(cx, cy, cx + cosf(sa) * 21, cy + sinf(sa) * 21, SSD1306_WHITE);
  display.fillCircle(cx, cy, 2, SSD1306_WHITE);
  display.setCursor(3, 56);
  int digitalHour = t.tm_hour;
  if (!use24h) { digitalHour %= 12; if (digitalHour == 0) digitalHour = 12; }
  display.print(two(digitalHour));
  display.print(':');
  display.print(two(t.tm_min));
  if (!use24h) {
    display.setCursor(39, 57);
    display.print(t.tm_hour >= 12 ? "PM" : "AM");
  }
  display.setCursor(84, 56);
  display.print("B2 BACK");
  drawTransitionOverlay();
  display.display();
}

void drawWeather() {
  display.clearDisplay();
  statusHeader("MALAPPURAM / NOW");
  if (!weatherOK) {
    display.setTextSize(1);
    display.setCursor(5, 26);
    display.print(weatherText);
    display.setCursor(5, 44);
    display.print("B2: REFRESH");
    display.display();
    return;
  }
  display.setTextSize(3);
  display.setCursor(4, 17);
  display.print(tempC, 1);
  display.print((char)247);
  display.print('C');

  // Quiet, compact weather glyph; no distracting animation.
  drawWeatherIcon(99, 19, weatherCode);
  display.setTextSize(1);
  display.setCursor(4, 43);
  display.print(weatherText);
  display.setCursor(4, 53);
  display.print("FEELS ");
  display.print(feelsC, 1);
  display.print("C  RH ");
  display.print(humidity);
  display.print('%');
  display.setCursor(4, 62);
  display.print("WIND ");
  display.print(windKmh, 1);
  display.print(" KM/H");
  drawTransitionOverlay();
  display.display();
}

void drawStopwatch() {
  display.clearDisplay();
  statusHeader("STOPWATCH");
  unsigned long elapsed = swElapsed + (swRunning ? millis() - swStart : 0);
  unsigned long centi = elapsed / 10;
  unsigned long mins = centi / 6000;
  unsigned long secs = (centi / 100) % 60;
  unsigned long tenth = (centi % 100) / 10;

  // Progress ring uses more of the screen.
  display.drawCircle(25, 37, 18, SSD1306_WHITE);
  int dotCount = (centi / 10) % 60;
  for (int i = 0; i < dotCount; i++) {
    float a = (i * 6 - 90) * PI / 180.0f;
    display.drawPixel(25 + cosf(a) * 22, 37 + sinf(a) * 22, SSD1306_WHITE);
  }

  display.setTextSize(2);
  display.setCursor(49, 24);
  display.print(two(mins));
  display.print(':');
  display.print(two(secs));
  display.setTextSize(1);
  display.setCursor(51, 43);
  display.print('.');
  display.print(tenth);
  display.print("  ");
  display.print(swRunning ? "RUN" : "PAUSE");
  display.setCursor(3, 57);
  display.print("B1 RESET  B2 START/STOP");
  drawTransitionOverlay();
  display.display();
}

void drawTimer() {
  display.clearDisplay();
  statusHeader("TIMER");
  unsigned long remaining = timerRemaining;
  if (timerRunning) {
    unsigned long elapsed = millis() - timerStarted;
    remaining = elapsed >= timerRemaining ? 0 : timerRemaining - elapsed;
    if (remaining == 0) {
      timerRunning = false;
      timerDone = true;
      timerRemaining = 0;
    }
  }

  unsigned long secsTotal = remaining / 1000;
  unsigned long mins = secsTotal / 60;
  unsigned long secs = secsTotal % 60;
  int cx = 64, cy = 34, r = 23;
  display.drawCircle(cx, cy, r, SSD1306_WHITE);

  if (!timerDone) {
    int progress = timerSetMs > 0 ? (int)(60.0f * remaining / timerSetMs) : 0;
    for (int i = 0; i < progress; i++) {
      float a = (i * 6 - 90) * PI / 180.0f;
      display.drawPixel(cx + cosf(a) * (r + 2), cy + sinf(a) * (r + 2), SSD1306_WHITE);
    }
    display.setTextSize(2);
    display.setCursor(35, 28);
    display.print(two(mins));
    display.print(':');
    display.print(two(secs));
  } else {
    display.setTextSize(2);
    display.setCursor(30, 27);
    display.print("TIME UP");
    if ((millis() / 250) % 2 == 0) display.drawRoundRect(1, 14, 126, 43, 5, SSD1306_WHITE);
  }

  display.setTextSize(1);
  display.setCursor(3, 58);
  display.print("B1 PRESET ");
  display.print(timerSetMs / 60000);
  display.print("M");
  display.setCursor(82, 58);
  display.print(timerRunning ? "B2 PAUSE" : "B2 START");
  drawTransitionOverlay();
  display.display();
}

void drawSystem() {
  display.clearDisplay();
  statusHeader("DEVICE STATUS");
  display.setTextSize(1);
  display.setCursor(3, 17);
  display.print("WIFI  ");
  display.print(WiFi.status() == WL_CONNECTED ? "CONNECTED" : "OFFLINE");
  display.setCursor(3, 28);
  display.print("TIME  ");
  display.print(time(nullptr) > 1700000000 ? "SYNCED" : "WAITING");
  display.setCursor(3, 39);
  display.print("WX    ");
  display.print(weatherOK ? "READY" : "NOT LOADED");
  display.setCursor(3, 50);
  display.print("HEAP  ");
  display.print(ESP.getFreeHeap() / 1024);
  display.print(" KB");
  display.setCursor(3, 60);
  display.print("IP ");
  if (WiFi.status() == WL_CONNECTED) display.print(WiFi.localIP());
  else display.print("NOT CONNECTED");
  drawTransitionOverlay();
  display.display();
}

void drawSettings() {
  display.clearDisplay();
  statusHeader("QUICK SETTINGS");

  const char* names[] = {"TIME FORMAT", "TRANSITIONS", "INVERT OLED"};
  const char* values[] = {
    use24h ? "24 HOUR" : "12 HOUR",
    motionUI ? "ON" : "OFF",
    inverted ? "ON" : "OFF"
  };

  for (int i = 0; i < 3; i++) {
    int y = 17 + i * 14;
    if (i == settingsFocus) {
      display.fillRoundRect(2, y - 2, 124, 13, 3, SSD1306_WHITE);
      display.setTextColor(SSD1306_BLACK);
    } else display.setTextColor(SSD1306_WHITE);

    display.setTextSize(1);
    display.setCursor(7, y);
    display.print(names[i]);
    display.setCursor(87, y);
    display.print(values[i]);
    display.setTextColor(SSD1306_WHITE);
  }
  display.setCursor(3, 59);
  display.print("B1 NEXT  B2 CHANGE");
  drawTransitionOverlay();
  display.display();
}

void render() {
  switch (app) {
    case HOME: drawHome(); break;
    case LAUNCHER: drawLauncher(); break;
    case ANALOG_APP: drawAnalog(); break;
    case WEATHER: drawWeather(); break;
    case STOPWATCH: drawStopwatch(); break;
    case TIMER: drawTimer(); break;
    case SYSTEM: drawSystem(); break;
    case SETTINGS: drawSettings(); break;
  }
}

void setup() {
  Serial.begin(115200);
  pinMode(BUTTON_1, INPUT_PULLUP);
  pinMode(BUTTON_2, INPUT_PULLUP);

  Wire.begin(OLED_SDA, OLED_SCL);
  if (!display.begin(SSD1306_SWITCHCAPVCC, OLED_ADDRESS)) {
    Serial.println("SSD1306 initialization failed");
    while (true) delay(1000);
  }
  display.setTextColor(SSD1306_WHITE);
  display.clearDisplay();
  display.display();
  bootAnimation();
  setupWiFi();
}

void loop() {
  networkTick();
  pollButtons();

  unsigned long now = millis();
  if (weatherRequest) {
    weatherRequest = false;
    fetchWeather();
  } else if (WiFi.status() == WL_CONNECTED &&
             (lastWeather == 0 || now - lastWeather >= WEATHER_PERIOD)) {
    fetchWeather();
  }

  if (now - lastFrame >= 32) {
    lastFrame = now;
    render();
  }
  delay(1);
}